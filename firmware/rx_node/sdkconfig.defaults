## firmware/rx_node/sdkconfig.defaults
```kconfig
# Settings adopted from espressif/esp-csi's csi_recv_router/sdkconfig.defaults.

# Required for esp_wifi_set_csi*.
CONFIG_ESP_WIFI_CSI_ENABLED=y

# Disable AMPDU - we want each MPDU to produce its own CSI callback. With
# aggregation enabled the radio batches frames and the effective CSI rate
# drops dramatically.
CONFIG_ESP_WIFI_AMPDU_TX_ENABLED=n
CONFIG_ESP_WIFI_AMPDU_RX_ENABLED=n
CONFIG_ESP_WIFI_DYNAMIC_RX_BUFFER_NUM=128
CONFIG_ESP_WIFI_DYNAMIC_TX_BUFFER_NUM=32

# 1 kHz tick rate matches upstream csi_recv_router. Lets ping_router_start
# hit 100 Hz cleanly (interval_ms=10 -> 10 ticks at 1 kHz, not rounded to 0).
CONFIG_FREERTOS_HZ=1000

# Generous watchdog timeout — esp_wifi_sta_get_ap_info / CSI cb spikes can
# briefly hold the main task. Matches upstream sdkconfig.defaults.
CONFIG_ESP_TASK_WDT_TIMEOUT_S=30

# CPU at 240 MHz (S3 default too) so the CSI cb keeps up at 100 Hz.
CONFIG_ESP32_DEFAULT_CPU_FREQ_240=y
CONFIG_ESP32S3_DEFAULT_CPU_FREQ_240=y

# Faster serial (matches upstream) so monitor doesn't bottleneck.
CONFIG_ESP_CONSOLE_UART_CUSTOM=y
CONFIG_ESP_CONSOLE_UART=y
CONFIG_ESP_CONSOLE_UART_NUM=0
CONFIG_ESP_CONSOLE_UART_BAUDRATE=921600
CONFIG_ESPTOOLPY_MONITOR_BAUD_921600B=y
CONFIG_ESPTOOLPY_MONITOR_BAUD=921600

CONFIG_LOG_DEFAULT_LEVEL_INFO=y
```

## firmware/tx_node/sdkconfig.defaults
```kconfig
# Settings adopted from espressif/esp-csi's csi_send example.

CONFIG_ESP_WIFI_CSI_ENABLED=y

# 1 kHz tick rate so usleep() granularity is ~1 ms (vs 10 ms at the default
# 100 Hz tick). Lets us actually hit the 500 Hz SEND_FREQUENCY target instead
# of being clamped to ~100 Hz by FreeRTOS tick rounding.
CONFIG_FREERTOS_HZ=1000

# Larger TX buffer pool so the 500 Hz burst doesn't backlog on the radio.
CONFIG_ESP_WIFI_STATIC_RX_BUFFER_NUM=10
CONFIG_ESP_WIFI_DYNAMIC_RX_BUFFER_NUM=32
CONFIG_ESP_WIFI_DYNAMIC_TX_BUFFER_NUM=128

# Disable AMPDU on the Tx side - each ESP-NOW broadcast should fly as its
# own frame so each Rx sees one CSI callback per Tx call.
CONFIG_ESP_WIFI_AMPDU_TX_ENABLED=n
CONFIG_ESP_WIFI_AMPDU_RX_ENABLED=n

CONFIG_LOG_DEFAULT_LEVEL_INFO=y
```
